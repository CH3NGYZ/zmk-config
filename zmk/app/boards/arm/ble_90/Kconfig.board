## zmk/app/boards/arm/ble_90/Kconfig.board
```kconfig
# isometria75 rev2 board configuration

# Copyright (c) 2020 The ZMK Contributors
# SPDX-License-Identifier: MIT

config BOARD_90_BLE
	bool "90_ble Keyboard"
	depends on SOC_NRF52840_QIAA
```
